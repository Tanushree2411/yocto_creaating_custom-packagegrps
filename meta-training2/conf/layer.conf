## meta-training2/conf/layer.conf
```bitbake
# We have a conf and classes directory, add to BBPATH
BBPATH .= ":${LAYERDIR}"

# We have recipes-* directories, add to BBFILES
BBFILES += "${LAYERDIR}/recipes-*/*/*.bb \
            ${LAYERDIR}/recipes-*/*/*.bbappend"

BBFILE_COLLECTIONS += "meta-training2"
BBFILE_PATTERN_meta-training2 = "^${LAYERDIR}/"
BBFILE_PRIORITY_meta-training2 = "6"

LAYERDEPENDS_meta-training2 = "core"
LAYERSERIES_COMPAT_meta-training2 = "warrior zeus"
```
